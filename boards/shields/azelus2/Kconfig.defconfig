## boards/shields/azelus6/Kconfig.defconfig
```kconfig
if SHIELD_AZELUS6_DONGLE  # SHIELD_AZELUS6_LEFT if LEFT should be central
config ZMK_KEYBOARD_NAME
    default "Azelus MK6"
config ZMK_SPLIT_ROLE_CENTRAL
    default y
endif

if SHIELD_AZELUS6_DONGLE
config ZMK_SPLIT_BLE_CENTRAL_PERIPHERALS
    default 2
config BT_MAX_CONN
    default 5
config BT_MAX_PAIRED
    default 5
endif

if SHIELD_AZELUS6_LEFT || SHIELD_AZELUS6_RIGHT || SHIELD_AZELUS6_DONGLE
config ZMK_SPLIT
    default y
endif
```

## boards/shields/azelus6/Kconfig.shield
```kconfig
config SHIELD_AZELUS6_LEFT
    def_bool $(shields_list_contains,azelus6_left)
config SHIELD_AZELUS6_RIGHT
    def_bool $(shields_list_contains,azelus6_right)
config SHIELD_AZELUS6_DONGLE
    def_bool $(shields_list_contains,azelus6_dongle)
```
